## boards/shields/Ennanas/Kconfig.defconfig
```kconfig
if SHIELD_Ennay_LEFT

# Name must be less than 16 characters long!
config ZMK_KEYBOARD_NAME
    default "Ennanas"

config ZMK_SPLIT_ROLE_CENTRAL
    default y

endif

if SHIELD_Ennay_LEFT || SHIELD_Ennay_RIGHT

config ZMK_SPLIT
    default y

endif
```

## boards/shields/Ennanas/Kconfig.shield
```kconfig
# No whitespace after the comma or in your part name!
config SHIELD_Ennay_LEFT
    def_bool $(shields_list_contains,Ennay_left)

# No whitespace after the comma or in your part name!
config SHIELD_Ennay_RIGHT
    def_bool $(shields_list_contains,Ennay_right)
```
